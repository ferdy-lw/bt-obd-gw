## sdkconfig.defaults
```kconfig
# Rust often needs a bit of an extra main task stack size compared to C (the default is 3K)
CONFIG_ESP_MAIN_TASK_STACK_SIZE=8000

# Use this to set FreeRTOS kernel tick frequency to 1000 Hz (100 Hz by default).
# This allows to use 1 ms granularity for thread sleeps (10 ms by default).
#CONFIG_FREERTOS_HZ=1000

# Workaround for https://github.com/espressif/esp-idf/issues/7631
#CONFIG_MBEDTLS_CERTIFICATE_BUNDLE=n
#CONFIG_MBEDTLS_CERTIFICATE_BUNDLE_DEFAULT_FULL=n

CONFIG_BT_BTC_TASK_STACK_SIZE=15000
CONFIG_BT_ENABLED=y
CONFIG_BT_BLUEDROID_ENABLED=y
CONFIG_BT_CLASSIC_ENABLED=y
CONFIG_BT_SPP_ENABLED=y
CONFIG_BT_SSP_ENABLED=n
#CONFIG_BT_BLE_ENABLED=n
CONFIG_BTDM_CTRL_MODE_BLE_ONLY=n
CONFIG_BTDM_CTRL_MODE_BR_EDR_ONLY=y
CONFIG_BTDM_CTRL_MODE_BTDM=n
CONFIG_BTDM_CTRL_BR_EDR_MAX_SYNC_CONN=1

# For coexist, pin BT to core 1, wifi stay on core 0
CONFIG_BTDM_CTRL_PINNED_TO_CORE=1
CONFIG_BT_BLUEDROID_PINNED_TO_CORE=1

# Default sleep=y
#CONFIG_BTDM_CTRL_MODEM_SLEEP=n
# Default coexist=y
#CONFIG_ESP_COEX_SW_COEXIST_ENABLE=y
# Default pm=n
#CONFIG_ESP_COEX_POWER_MANAGEMENT=n
# Coexist sets/forces If ESP_WIFI_ENABLED; default pm=y
#CONFIG_ESP_WIFI_STA_DISCONNECTED_PM_ENABLE


#10 - higher or equal to rx ba win
#CONFIG_ESP_WIFI_STATIC_RX_BUFFER_NUM=5
#32
#CONFIG_ESP_WIFI_DYNAMIC_RX_BUFFER_NUM=10
#32
#CONFIG_ESP_WIFI_DYNAMIC_TX_BUFFER_NUM=10
##ESP_WIFI_STATIC_TX_BUFFER=n
##ESP_WIFI_DYNAMIC_TX_BUFFER=y
#CONFIG_ESP_WIFI_TX_BUFFER_TYPE=1
#6
#CONFIG_ESP_WIFI_RX_BA_WIN=3
#6
#CONFIG_ESP_WIFI_TX_BA_WIN=3
#short buf- 32
#CONFIG_ESP_WIFI_MGMT_SBUF_NUM=10
#CONFIG_ESP_WIFI_RX_IRAM_OPT=n
#5760
#CONFIG_LWIP_TCP_SND_BUF_DEFAULT=2880
#5760
#CONFIG_LWIP_TCP_WND_DEFAULT=2880
#WND_DEFAULT/TCP_MSS + 2
#6
#CONFIG_LWIP_TCP_RECVMBOX_SIZE=4
#6
#CONFIG_LWIP_TCP_ACCEPTMBOX_SIZE=4
#6
#CONFIG_LWIP_UDP_RECVMBOX_SIZE=4
#32
#CONFIG_LWIP_TCPIP_RECVMBOX_SIZE=8
```
